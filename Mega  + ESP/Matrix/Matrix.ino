#include <LEDMatrixDriver.hpp>
const uint8_t LEDMATRIX_CS_PIN = 9;
const int LEDMATRIX_SEGMENTS = 4;
const int LEDMATRIX_WIDTH    = LEDMATRIX_SEGMENTS * 8;
LEDMatrixDriver lmd(LEDMATRIX_SEGMENTS, LEDMATRIX_CS_PIN);
LEDMatrixDriver lmd2(LEDMATRIX_SEGMENTS / 2, LEDMATRIX_CS_PIN);
byte font[95][8] = { {0, 0, 0, 0, 0, 0, 0, 0}, // SPACE
  {0x10, 0x18, 0x18, 0x18, 0x18, 0x00, 0x18, 0x18}, // EXCL
  {0x28, 0x28, 0x08, 0x00, 0x00, 0x00, 0x00, 0x00}, // QUOT
  {0x00, 0x0a, 0x7f, 0x14, 0x28, 0xfe, 0x50, 0x00}, // #
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  {0x00, 0x7c, 0x04, 0x08, 0x7c, 0x20, 0x40, 0xfe}, // Z
  // (the font does not contain any lower case letters. you can add your own.)
};
int AnimIndex = 0;
const int AnimDelay = 100;
char text[100];
int x = 0, y = 0; // start top left
int textindex;

char firstChar;
bool GotFirstChar = false;
bool stringComplete = false;  // whether the string is complete

void setup() {
  lmd.setEnabled(true);
  lmd.setIntensity(2);   // 0 = low, 10 = high
  lmd2.setEnabled(true);
  lmd2.setIntensity(2);   // 0 = low, 10 = high

  Serial.begin(115200);
  // reserve 200 bytes for the inputString:
}
void loop() {
  if (stringComplete) {

switch(firstChar){
  case 'A':
  AppName(text);
    break;

    default:
    AppContent(text);
    break;
}
    

  }
}

void DrawTextDown(char* text, int len, int x, int y ) {
  for ( int idx = 0; idx < len; idx ++ )
  {
    int c = text[idx] - 32;

    // stop if char is outside visible area
    if ( x + idx * 8  > LEDMATRIX_WIDTH)
      return;

    // only draw if char is visible
    if ( 8 + x + idx * 8 > LEDMATRIX_WIDTH / 2 + 7)
      drawSprite( font[c], x + idx * 8, y, 8, 8 );
  }
}
void DrawTextUp(char* text, int len, int x, int y ) {
  for ( int idx = 0; idx < len; idx ++ )
  {
    int c = text[idx] - 32;

    // stop if char is outside visible area
    if ( x + idx * 8  > LEDMATRIX_WIDTH / 2 - 7)
      return;

    // only draw if char is visible
    if ( 8 + x + idx * 8 > 0)
      drawSprite( font[c], x + idx * 8, y, 8, 8 );
  }
}
void DrawTextBoth(char* text, int len, int x, int y ) {
  for ( int idx = 0; idx < len; idx ++ )
  {
    int c = text[idx] - 32;

    // stop if char is outside visible area
    if ( x + idx * 8  > LEDMATRIX_WIDTH / 2)
      return;

    // only draw if char is visible
    if ( 8 + x + idx * 8 > 0)
      drawSprite2( font[c], x + idx * 8, y, 8, 8 );
  }
}


void drawSprite( byte* sprite, int x, int y, int width, int height ) {
  // The mask is used to get the column bit from the sprite row
  byte mask = B10000000;

  for ( int iy = 0; iy < height; iy++ )
  {
    for ( int ix = 0; ix < width; ix++ )
    {
      lmd.setPixel(x + ix, y + iy, (bool)(sprite[iy] & mask ));

      // shift the mask by one pixel to the right
      mask = mask >> 1;
    }

    // reset column mask
    mask = B10000000;
  }
  lmd.display();
}
void drawSprite2( byte* sprite, int x, int y, int width, int height ) {
  // The mask is used to get the column bit from the sprite row
  byte mask = B10000000;

  for ( int iy = 0; iy < height; iy++ )
  {
    for ( int ix = 0; ix < width; ix++ )
    {
      lmd2.setPixel(x + ix, y + iy, (bool)(sprite[iy] & mask ));

      // shift the mask by one pixel to the right
      mask = mask >> 1;
    }

    // reset column mask
    mask = B10000000;
  }
  lmd2.display();

}
void drawString(char* text, int len, int x, int y ) {
  for ( int idx = 0; idx < len; idx ++ )
  {
    int c = text[idx] - 32;

    // stop if char is outside visible area
    if ( x + idx * 8  > LEDMATRIX_WIDTH )
      return;

    // only draw if char is visible
    if ( 8 + x + idx * 8 > 0 )
      drawSprite( font[c], x + idx * 8, y, 8, 8 );
  }
}

void serialEvent() {
  while (Serial.available()) {
    // get the new byte:
    char inChar = (char)Serial.read() & ~(0x20);
    if (!GotFirstChar) {
      firstChar = inChar;
      GotFirstChar = true;
    }
    else if (inChar == '\0' || inChar == '\n' || inChar == '\r' ) {
      stringComplete = true;
      return;
    }
    else {

      // add it to the inputString:
      text[textindex] = inChar;
      textindex ++;
      // if the incoming character is a newline, set a flag so the main loop can
      // do something about it:
    }

  }
}

void AppName(char* text){
      int len = strlen(text);
      if ( --x < len * -8 ) {
      x = LEDMATRIX_WIDTH;
      memset(text, '\0', sizeof(text));
      textindex = 0;
      GotFirstChar = false;
      stringComplete = false;
    }
    DrawTextUp(text, len, x, 0);
    delay(AnimDelay);
}

void AppContent(char* text){
      int len = strlen(text);
      if ( --x < len * -8 ) {
      x = LEDMATRIX_WIDTH;
      memset(text, '\0', sizeof(text));
      textindex = 0;
      GotFirstChar = false;
      stringComplete = false;
    }
    DrawTextDown(text, len, x, 0);
    delay(AnimDelay);
}
